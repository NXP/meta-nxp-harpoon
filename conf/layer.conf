## conf/layer.conf
```bitbake
# We have a conf and classes directory, add to BBPATH
BBPATH .= ":${LAYERDIR}"

# We have recipes-* directories, add to BBFILES
BBFILES += "${LAYERDIR}/recipes-*/*/*.bb \
            ${LAYERDIR}/recipes-*/*/*.bbappend"

BBFILE_COLLECTIONS += "meta-nxp-harpoon"
BBFILE_PATTERN_meta-nxp-harpoon = "^${LAYERDIR}/"
BBFILE_PRIORITY_meta-nxp-harpoon = "9"

LAYERDEPENDS_meta-nxp-harpoon = "core"
LAYERSERIES_COMPAT_meta-nxp-harpoon = "walnascar"

KERNEL_DEVICETREE:append:imx8mm-lpddr4-evk = " \
                                              freescale/imx8mm-evk-harpoon.dtb \
                                              freescale/imx8mm-evk-qca-wifi-harpoon.dtb \
                                              freescale/imx8mm-evk-harpoon-avb.dtb \
                                              freescale/imx8mm-evk-qca-wifi-harpoon-avb.dtb \
                                              freescale/imx8mm-evk-harpoon-industrial.dtb \
                                              freescale/imx8mm-evk-qca-wifi-harpoon-industrial.dtb \
                                             "
KERNEL_DEVICETREE:append:imx8mn-lpddr4-evk = " \
                                              freescale/imx8mn-evk-harpoon.dtb \
                                              freescale/imx8mn-evk-harpoon-avb.dtb \
                                              freescale/imx8mn-evk-harpoon-industrial.dtb \
                                             "
KERNEL_DEVICETREE:append:imx8mp-lpddr4-evk = " \
                                              freescale/imx8mp-evk-harpoon.dtb \
                                              freescale/imx8mp-evk-harpoon-avb.dtb \
                                              freescale/imx8mp-evk-harpoon-industrial.dtb \
                                             "
KERNEL_DEVICETREE:append:imx93evk = " \
                                              freescale/imx93-11x11-evk-harpoon.dtb \
                                              freescale/imx93-11x11-evk-harpoon-avb.dtb \
                                              freescale/imx93-11x11-evk-harpoon-industrial.dtb \
                                             "

KERNEL_DEVICETREE:append:imx95-15x15-lpddr4x-evk = " \
                                              freescale/imx95-15x15-evk-harpoon.dtb \
                                              freescale/imx95-15x15-evk-harpoon-industrial.dtb \
                                             "
KERNEL_DEVICETREE:append:imx95-19x19-lpddr5-evk = " \
                                              freescale/imx95-19x19-evk-harpoon.dtb \
                                              freescale/imx95-19x19-evk-harpoon-industrial.dtb \
                                             "

IMAGE_INSTALL:append = " \
    packagegroup-harpoon \
    packagegroup-harpoon-test \
"

# Use Real-Time-Edge System Manager config
SYSTEM_MANAGER_CONFIG:imx95-19x19-lpddr5-evk = "mx95rte"
SYSTEM_MANAGER_CONFIG:imx95-15x15-lpddr4x-evk = "mx95rte"

# boot image config
IMAGE_IMXBOOT_TARGET:imx95-19x19-lpddr5-evk = "${IMXBOOT_TARGETS_BASENAME}_a55"
IMAGE_IMXBOOT_TARGET:imx95-15x15-lpddr4x-evk = "${IMXBOOT_TARGETS_BASENAME}_a55"
```
